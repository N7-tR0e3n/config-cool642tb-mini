## config/west.yml
```yaml
manifest:
  remotes:
    - name: cormoran
      url-base: https://github.com/cormoran
    - name: zmkfirmware
      url-base: https://github.com/zmkfirmware
  projects:
    # すべての依存をコミット SHA で固定する（2026-10-05 時点の各ブランチ先端）。
    # 上げるときは SHA を書き換え、ビルドと実機の動作を確かめてから次へ進む。

    # ZMK 本体: cormoran/zmk main+dya
    - name: zmk
      remote: cormoran
      revision: e5c9b6915b56801193e359dd9bad4a167ce0d1b8
      import:
        file: app/west.yml
        name-blocklist:
          - zephyr # zephyr は下で SHA 固定するので、ZMK 側の定義は取り込まない

    # Zephyr: cormoran/zephyr v4.1.0+zmk-fixes+nrf-half-duplex-uart
    # clone-depth は付けない（付けるとブランチが進んだ後にこの SHA を取得できなくなる）
    - name: zephyr
      remote: zmkfirmware
      revision: 10ba6d0cb38bc3d258775d27982f707599320085
      import:
        name-blocklist:
          - ci-tools
          - hal_altera
          - hal_cypress
          - hal_infineon
          - hal_microchip
          - hal_nxp
          - hal_openisa
          - hal_xtensa
          - hal_st
          - hal_ti
          - loramac-node
          - mcuboot
          - mcumgr
          - net-tools
          - openthread
          - edtt
          - trusted-firmware-m

    # DYA Studio Core
    - name: zmk-feature-custom-settings
      remote: cormoran
      revision: 11fc4dda8ac11b1ff33101a6e59377021fec381b
    - name: zmk-feature-fast-keymap
      remote: cormoran
      revision: 8dac76de0ba38588ba39ca498910e24f8332bc6b

    # DYA Studio Keymap Macro Combo
    - name: zmk-feature-runtime-macro
      remote: cormoran
      revision: 38530962eb7061b60efcb98e84585cfb1f0cb6de
    - name: zmk-feature-runtime-combo
      remote: cormoran
      revision: d9490e7b5d41c516221d131241009e81740efcee
    - name: zmk-feature-input-stream # 押下キー表示が必要な場合だけ
      remote: cormoran
      revision: aeb015908a42a7615ccdccc7feb3a10d23132a71
    - name: zmk-feature-module-physical-layout # プレビューに拡張モジュールを表示する場合だけ
      remote: cormoran
      revision: 4f18de45dc27820725d267916b4cdacc0e0b6cf9

    # DYA Studio Trackball
    - name: zmk-driver-pmw3610-with-custom-studio-rpc
      remote: cormoran
      revision: 5c34ea0eec246a1c986111417cd779b53144629a
    - name: zmk-module-runtime-input-processor
      remote: cormoran
      revision: decf628d7ce5ed95b520c650824c28ea9de649c1

    # DYA Rotary Encoder
    - name: zmk-behavior-runtime-sensor-rotate
      remote: cormoran
      revision: 8b1125ed676c1f5e14145d217984f33d0ebdcef4

    # DYA Diagnostics Development
    - name: zmk-feature-device-info
      remote: cormoran
      revision: 8cedd2dd9f04e19ea5a17b94914dd47a09d8db11
    - name: zmk-feature-watchdog
      remote: cormoran
      revision: 84ad14c6c3645dc40b23f45d08ab45418655f912
    - name: zmk-module-devtool
      remote: cormoran
      revision: 9938a2c73c06d6e65ba2c0b68c9aa044a467eafc
    - name: zmk-feature-zephyr-setting-expose
      remote: cormoran
      revision: 5c89bc71122840ea46032fc241bef8665b99728a
    - name: zmk-feature-kscan-diagnostics
      remote: cormoran
      revision: 1432f7fe0cfe903cd7d3c9931ae6bd6f2e1f328e

    # DYA OS
    - name: zmk-module-ble-management
      remote: cormoran
      revision: 57738cc4fc6ba80e82a7ac57741a0339cb186cd4
    - name: zmk-feature-default-layer # ブランチ codex/custom-rpc-rewrite の先端
      remote: cormoran
      revision: b25cb5b324da2d9bbc84e1877c775f5b2b7c6845
    - name: zmk-feature-os-detection # default-layer が依存するので、default-layer を使う間は消さない
      remote: cormoran
      revision: 3052679f645b8fc1997275c2eaa6b86bdd55ca01

    # DYA Settings
    - name: zmk-module-settings-rpc
      remote: cormoran
      revision: 78f86df9e6c5edaf57bef3ccbd7f360cfdf49291

  self:
    path: config
```
